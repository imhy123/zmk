## app/module/drivers/sensor/ec11/Kconfig
```kconfig
# Copyright (c) 2020 The ZMK Contributors
# SPDX-License-Identifier: MIT

menuconfig EC11
    bool "EC11 Incremental Encoder Sensor"
    default y
    depends on DT_HAS_ALPS_EC11_ENABLED
    depends on GPIO
    help
      Enable driver for EC11 incremental encoder sensors.

if EC11

choice EC11_TRIGGER_MODE
    prompt "Trigger mode"
    default EC11_TRIGGER_NONE
    help
      Specify the type of triggering to be used by the driver.

config EC11_TRIGGER_NONE
    bool "No trigger"

config EC11_TRIGGER_GLOBAL_THREAD
    bool "Use global thread"
    depends on GPIO
    select EC11_TRIGGER

config EC11_TRIGGER_OWN_THREAD
    bool "Use own thread"
    depends on GPIO
    select EC11_TRIGGER

endchoice

config EC11_TRIGGER
    bool

config EC11_THREAD_PRIORITY
    int "Thread priority"
    depends on EC11_TRIGGER_OWN_THREAD
    default 10
    help
      Priority of thread used by the driver to handle interrupts.

config EC11_THREAD_STACK_SIZE
    int "Thread stack size"
    depends on EC11_TRIGGER_OWN_THREAD
    default 1024
    help
      Stack size of thread used by the driver to handle interrupts.

config EC11_DEBUG_TRACE
    bool "Trace decoded EC11 transitions over the log (debug only)"
    help
      Push every decoded transition (and the emit/glitch decision) into a queue
      from the ISR and log it from a low-priority thread. The ISR never logs, so
      this is safe to leave on while debugging. Use it to see, per detent, how
      many transitions arrive and why a detent is or is not emitted.

endif # EC11
```

## app/module/dts/bindings/sensor/alps,ec11.yaml
```yaml
description: |
  Sensor driver for the Alps EC11 rotary encoder

compatible: "alps,ec11"

properties:
  label:
    type: string
    required: false
    deprecated: true
  a-gpios:
    type: phandle-array
    required: true
    description: A pin for the encoder
  b-gpios:
    type: phandle-array
    required: true
    description: A pin for the encoder
  resolution:
    type: int
    description: Number of pulses per tick
    deprecated: true
    required: false
  steps:
    type: int
    description: Number of pulses in one full rotation
    required: false
  pulses-per-detent:
    type: int
    description: |
      Number of valid quadrature transitions that make up one physical detent.
      Counted once per detent; contact bounce (alternating +1/-1 transitions)
      cancels out before reaching this threshold. Defaults to 2.
    required: false
  filter-reverse-guard-us:
    type: int
    description: |
      Directional glitch filter. If >0, a detent in the opposite direction to
      the last emitted one is treated as a glitch when it completes within this
      many microseconds of the last same-direction transition (a real reversal
      has a larger velocity-through-zero gap). No edges are dropped. 0 disables.
      Defaults to 800.
    required: false
  filter-reverse-as-codir:
    type: int
    description: |
      How a glitch caught by filter-reverse-guard-us is handled. Nonzero: emit a
      detent in the committed direction (the glitch is misdecoded same-direction
      motion), so the count does not lag. 0: drop the glitch entirely. Defaults to 0.
    required: false
  filter-codir-guard-us:
    type: int
    description: |
      Minimum time since the last emitted detent before an inferred detent may
      fire -- this gates both the same-direction (codir) recovery and the 2-step
      jump compensation (filter-jump-compensate). An inferred emit sooner than
      this is boundary chatter within one physical detent and is dropped, so one
      detent cannot emit more than once; later than this it is a genuinely missed
      detent and is recovered. 0 disables the gate. Defaults to 3000.
    required: false
  filter-jump-compensate:
    type: int
    description: |
      When both A and B change between two reads (a 2-step jump), two edges of one
      detent collapsed into a single read and the direction is ambiguous. Nonzero:
      compensate the otherwise-lost detent by resolving the jump as two transitions
      in the committed direction. 0: drop it. Defaults to 1.
    required: false
```
